## contrib/fake-pmem/Kconfig
```kconfig
config FAKE_PMEM
tristate "Fake persistent memory support"
depends on X86_64
default y if X86_64
help
  allocates and leaks 2M for use of emulated persistent memory in a kexec kernel.
```

## deploy/coreboot-rom/x11ssh-tf.defconfig
```kconfig
CONFIG_VENDOR_SUPERMICRO=y
CONFIG_NO_POST=y
CONFIG_SOC_INTEL_COMMON_BLOCK_SGX_ENABLE=y
CONFIG_HAVE_IFD_BIN=y
CONFIG_BOARD_SUPERMICRO_X11SSH_TF=y
CONFIG_USE_LEGACY_8254_TIMER=y
CONFIG_VALIDATE_INTEL_DESCRIPTOR=y
CONFIG_HAVE_ME_BIN=y
CONFIG_CHECK_ME=y
CONFIG_LOCK_MANAGEMENT_ENGINE=y
CONFIG_NO_GFX_INIT=y
CONFIG_VPD=y
CONFIG_USER_TPM2=y
CONFIG_TPM_MEASURED_BOOT=y
CONFIG_CONSOLE_CBMEM_BUFFER_SIZE=0x80000
CONFIG_PAYLOAD_NONE=y
```

## stboot-installation/coreboot-payload/x86_64_qemu_q35_coreboot.defconfig
```kconfig
CONFIG_BOARD_EMULATION_QEMU_X86_Q35=y
CONFIG_COREBOOT_ROMSIZE_KB_16384=y
CONFIG_USER_TPM2=y
CONFIG_TPM_MEASURED_BOOT=y
CONFIG_PAYLOAD_NONE=y
```

## stboot/coreboot-firmware/x11ssh-tf.defconfig
```kconfig
CONFIG_USE_OPTION_TABLE=y
CONFIG_USE_BLOBS=y
CONFIG_VENDOR_SUPERMICRO=y
CONFIG_VBOOT=y
CONFIG_HAVE_IFD_BIN=y
CONFIG_ADD_FSP_BINARIES=y
CONFIG_NO_POST=y
CONFIG_BOARD_SUPERMICRO_X11SSH_TF=y
# CONFIG_VBOOT_SLOTS_RW_AB is not set
CONFIG_SOC_INTEL_COMMON_BLOCK_SGX_PRMRR_SIZE_MAX=y
CONFIG_VALIDATE_INTEL_DESCRIPTOR=y
CONFIG_HAVE_ME_BIN=y
CONFIG_CHECK_ME=y
CONFIG_LOCK_MANAGEMENT_ENGINE=y
CONFIG_NO_GFX_INIT=y
CONFIG_SOFTWARE_I2C=y
CONFIG_VPD=y
CONFIG_FSP_USE_REPO=y
CONFIG_VBOOT_MEASURED_BOOT=y
CONFIG_USER_TPM2=y
CONFIG_BOOTMEDIA_LOCK_VBOOT_RO=y
CONFIG_CONSOLE_CBMEM_BUFFER_SIZE=0x80000
CONFIG_PAYLOAD_NONE=y
# CONFIG_COMPRESS_SECONDARY_PAYLOAD is not set
```
